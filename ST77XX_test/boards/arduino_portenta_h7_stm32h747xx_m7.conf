## ST77XX_test/boards/arduino_portenta_h7_stm32h747xx_m7.conf
```kconfig
CONFIG_USB_DEVICE_STACK=y
CONFIG_USB_DEVICE_PRODUCT="Arduino Portenta H7"
CONFIG_USB_DEVICE_MANUFACTURER="Arduino"
CONFIG_USB_DEVICE_VID=0x2341
CONFIG_USB_DEVICE_PID=0x005b

#CONFIG_USB_CDC_ACM=y
#CONFIG_USB_CDC_ACM_RINGBUF_SIZE=512
#CONFIG_UART_LINE_CTRL=y
#CONFIG_CDC_ACM_DTE_RATE_CALLBACK_SUPPORT=y

CONFIG_LLEXT_STORAGE_WRITABLE=n

CONFIG_SHARED_MULTI_HEAP=y
CONFIG_HEAP_MEM_POOL_SIZE=2048
CONFIG_SHELL_STACK_SIZE=32768
CONFIG_MAIN_STACK_SIZE=32768
CONFIG_LLEXT_HEAP_SIZE=128

CONFIG_FPU=y
CONFIG_ICACHE=y
CONFIG_DCACHE=y
CONFIG_CACHE_MANAGEMENT=y

CONFIG_USERSPACE=n
CONFIG_ARM_MPU=y
CONFIG_MAX_THREAD_BYTES=4

#CONFIG_SHELL_STACK_SIZE=32768
#CONFIG_MAIN_STACK_SIZE=32768
#CONFIG_LLEXT_HEAP_SIZE=128

CONFIG_ADC=y
CONFIG_PWM=y
CONFIG_DMA=y
CONFIG_MEMC=y
CONFIG_SPI=y
CONFIG_SPI_ASYNC=y
CONFIG_SPI_STM32_INTERRUPT=y

CONFIG_NET_CORE_LOG_LEVEL_DBG=y


# from prj.conf... of Arduino
CONFIG_LOG=y
CONFIG_LOG_MODE_IMMEDIATE=y

CONFIG_GPIO=y
CONFIG_PINCTRL=y
CONFIG_I2C=y
CONFIG_SPI=y
```

## cdc_acm_bridge/boards/arduino_portenta_h7_stm32h747xx_m7.conf
```kconfig
CONFIG_USB_DEVICE_STACK=y
CONFIG_USB_DEVICE_PRODUCT="Arduino Portenta H7"
CONFIG_USB_DEVICE_MANUFACTURER="Arduino"
CONFIG_USB_DEVICE_VID=0x2341
CONFIG_USB_DEVICE_PID=0x005b

CONFIG_SHELL_STACK_SIZE=32768
CONFIG_MAIN_STACK_SIZE=32768
```

## cdc_acm_bridge/boards/teensy41.conf
```kconfig
CONFIG_USB_DEVICE_STACK=y
6c0
CONFIG_USB_DEVICE_PID=0x0483

CONFIG_USB_DEVICE_PRODUCT="Teensyduino"

CONFIG_SHELL_STACK_SIZE=32768
CONFIG_MAIN_STACK_SIZE=32768
```

## ov5640_to_ili9341/boards/teensymm.conf
```kconfig
CONFIG_USB_CDC_ACM=y
CONFIG_USB_CDC_ACM_RINGBUF_SIZE=512
CONFIG_UART_LINE_CTRL=y
CONFIG_CDC_ACM_DTE_RATE_CALLBACK_SUPPORT=y


CONFIG_UART_INTERRUPT_DRIVEN=y
CONFIG_USB_DEVICE_INITIALIZE_AT_BOOT=n
CONFIG_GPIO=y
CONFIG_SPI=y
CONFIG_SPI_ASYNC=y
CONFIG_POLL=y
CONFIG_STATIC_INIT_GNU=y

# Enable uart driver
CONFIG_SERIAL=y

# Console
CONFIG_CONSOLE=y
CONFIG_UART_CONSOLE=y
CONFIG_USB_CDC_ACM_LOG_LEVEL_DBG=n
#CONFIG_USB_DEVICE_STACK_NEXT=y
#CONFIG_SPI_LOG_LEVEL_DBG=y


#CONFIG_STDOUT_CONSOLE=y
CONFIG_USB_DEVICE_STACK=y
CONFIG_USB_DEVICE_PRODUCT="Teensy Serial"
CONFIG_USB_DEVICE_VID=0x16c0
CONFIG_USB_DEVICE_PID=0x0483
CONFIG_LOG=y
CONFIG_USB_DRIVER_LOG_LEVEL_ERR=y
CONFIG_USB_DEVICE_LOG_LEVEL_ERR=y
CONFIG_SERIAL=y
```
